/include/ "system-conf.dtsi"

/ {
	/* Bring-up only. Disable this UIO node when the DMA shim owns the core. */
	state_estimator_uio: state-estimator-uio@a0000000 {
		compatible = "generic-uio";
		reg = <0x0 0xa0000000 0x0 0x00010000>;
		status = "okay";
	};

	/* Enable after AXI DMA and interrupt phandles are generated by Vivado. */
	state_estimator: state-estimator@a0000000 {
		compatible = "cornell-rocketry,state-estimator-1.0";
		reg = <0x0 0xa0000000 0x0 0x00010000>;
		dma-names = "s2mm", "mm2s";
		status = "disabled";
	};
};
